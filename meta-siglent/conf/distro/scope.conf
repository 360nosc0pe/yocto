## meta-siglent/conf/distro/scope.conf
```bitbake
DISTRO_FEATURES= "ext2 nfs usbgadget usbhost ${DISTRO_FEATURES_LIBC}"
#largefile wifi xattr nfs

# Prevent stacking up hundreds of old builds by not including a DATETIME in the image name
IMAGE_NAME = "${IMAGE_BASENAME}-${MACHINE}"
```

## meta-siglent/conf/machine/sds1202xe.conf
```bitbake
#@TYPE: Machine
#@NAME: sds1202xe
#@DESCRIPTION: Machine support for Siglent SDS1202X-E

SOC_VARIANT ?= "7z"

PREFERRED_PROVIDER_virtual/kernel ?= "linux-xlnx"
PREFERRED_VERSION_linux-xlnx ?= "4.14%"
PREFERRED_PROVIDER_virtual/dtb ?= "device-tree"

PREFERRED_PROVIDER_virtual/bitstream ?= "siglent-fpga"
PREFERRED_PROVIDER_virtual/xilinx-platform-init ?= "siglent-fpga"
PREFERRED_PROVIDER_virtual/ps7-tcl-init ?= "siglent-fpga"

#meta-xilinx
require conf/machine/include/tune-zynq.inc
require conf/machine/include/machine-xilinx-default.inc
require conf/machine/include/machine-xilinx-board.inc

MACHINE_FEATURES = "ext2 vfat usbhost usbgadget screen serial"

UBOOT_MACHINE = "zynq_sds1202xe_config"
#SPL_BINARY = "spl/boot.bin"
#FORCE_PLATFORM_INIT = "1"

SERIAL_CONSOLE = "115200 ttyPS0"

MACHINE_ESSENTIAL_EXTRA_RDEPENDS += "device-tree"
MACHINE_ESSENTIAL_EXTRA_RRECOMMENDS += "kernel-modules"

EXTRA_IMAGEDEPENDS += " \
    virtual/bitstream \
    virtual/ps7-tcl-init \
    "

IMAGE_BOOT_FILES += "${MACHINE}.dtb"
```

## scripts/conf/bblayers.conf
```bitbake
# POKY_BBLAYERS_CONF_VERSION is increased each time build/conf/bblayers.conf
# changes incompatibly
POKY_BBLAYERS_CONF_VERSION = "2"

BBPATH = "${TOPDIR}"
BSPDIR := "${@os.path.abspath(os.path.dirname(d.getVar('FILE', True)) + '/../..')}"

BBFILES ?= ""

BBLAYERS ?= " \
  ${BSPDIR}/poky/meta \
  ${BSPDIR}/poky/meta-poky \
  ${BSPDIR}/poky/meta-yocto-bsp \
  \
  ${BSPDIR}/meta-xilinx/meta-xilinx-bsp \
  \
  ${BSPDIR}/meta-siglent \
  "
```
